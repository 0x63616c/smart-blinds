## firmware/esp-idf-thread/sdkconfig.defaults
```kconfig
CONFIG_IDF_TARGET="esp32c6"
CONFIG_ESPTOOLPY_FLASHSIZE_4MB=y
CONFIG_PARTITION_TABLE_CUSTOM=y
CONFIG_PARTITION_TABLE_CUSTOM_FILENAME="partitions.csv"
CONFIG_PARTITION_TABLE_FILENAME="partitions.csv"
CONFIG_ESP_CONSOLE_USB_SERIAL_JTAG=y
CONFIG_ESP_CONSOLE_SECONDARY_NONE=y
CONFIG_COMPILER_CXX_EXCEPTIONS=n
CONFIG_COMPILER_CXX_RTTI=n
CONFIG_OPENTHREAD_ENABLED=y
CONFIG_OPENTHREAD_MTD=y
CONFIG_OPENTHREAD_FTD=n
CONFIG_OPENTHREAD_BORDER_ROUTER=n
CONFIG_OPENTHREAD_CLI=n
CONFIG_OPENTHREAD_CONSOLE_ENABLE=n
CONFIG_OPENTHREAD_TASK_SIZE=8192
CONFIG_OPENTHREAD_HEADER_CUSTOM=y
CONFIG_OPENTHREAD_CUSTOM_HEADER_PATH="main"
CONFIG_OPENTHREAD_CUSTOM_HEADER_FILE_NAME="ot_custom_config.h"
CONFIG_MBEDTLS_CMAC_C=y
CONFIG_MBEDTLS_SSL_PROTO_DTLS=y
CONFIG_MBEDTLS_PSK_MODES=y
CONFIG_MBEDTLS_KEY_EXCHANGE_PSK=y
CONFIG_MBEDTLS_KEY_EXCHANGE_ECJPAKE=y
CONFIG_MBEDTLS_ECJPAKE_C=y
CONFIG_LWIP_TCPIP_TASK_STACK_SIZE=4096
CONFIG_LWIP_IPV6_NUM_ADDRESSES=8
CONFIG_LWIP_IPV4=n
CONFIG_LWIP_ND6=n
CONFIG_IEEE802154_ENABLED=y
CONFIG_PM_ENABLE=y
CONFIG_FREERTOS_USE_TICKLESS_IDLE=y
CONFIG_PM_POWER_DOWN_PERIPHERAL_IN_LIGHT_SLEEP=y
CONFIG_IEEE802154_SLEEP_ENABLE=y
CONFIG_FREERTOS_HZ=1000
CONFIG_ESP_SLEEP_POWER_DOWN_FLASH=y
CONFIG_ESP_PHY_MAC_BB_PD=y
CONFIG_ESP_MAIN_TASK_STACK_SIZE=6144
```

## firmware/esp-idf-wifi-motion/main/Kconfig.projbuild
```kconfig
menu "Smart blinds Wi-Fi evaluation"
    config SB_WIFI_PLAINTEXT_DISPOSABLE_BENCH
        bool "Permit disposable bench credentials without flash encryption"
        default n
        help
            Explicit bench-only exception for disposable keys and a test AP.
            Default requires already enabled flash encryption. This firmware
            does not provision keys, burn eFuses or enable flash encryption.
            Never use this exception for the owner's network or production keys.
endmenu
```

## firmware/esp-idf/components/gauge_continuity/Kconfig
```kconfig
menu "Smart blinds read-only gauge continuity bench adapter"
config BLINDS_GAUGE_CONTINUITY_BENCH
    bool "Permit explicitly qualified read-only gauge attachment"
    depends on IDF_TARGET_ESP32C6
    default n
    help
        Compile-time bench gate only. The experimental motion runtime also
        requires an explicit local handoff qualification before attachment.
        Attachment also requires explicit boot-bound pack/continuity records.
        It cannot create a bus, write a register or approve physical actuation.
endmenu
```

## firmware/esp-idf/components/motion_io/Kconfig
```kconfig
menu "Smart Blinds bench motion"
    config BLINDS_BENCH_MOTION
        bool "Compile permission for explicit bench motion initialization"
        default n
        depends on PM_ENABLE
        help
            Enables initialization permission only. The default Thread runtime
            supplies empty qualification records. Reviewed bench profiles and a
            physical reference are still required. Never enable for an unqualified board.
endmenu
```
